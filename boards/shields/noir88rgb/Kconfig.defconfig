## boards/shields/noir88rgb/Kconfig.defconfig
```kconfig
if SHIELD_NOIR88_LEFT

config ZMK_KEYBOARD_NAME
    default "Noir88"

config ZMK_SPLIT_ROLE_CENTRAL
    default y

endif

if SHIELD_noir88rgb_LEFT || SHIELD_noir88rgb_RIGHT

config ZMK_SPLIT
    default y

if ZMK_RGB_UNDERGLOW

config WS2812_STRIP
    default y
endif

endif
```

## boards/shields/noir88rgb/Kconfig.shield
```kconfig
# Copyright (c) 2020 Noir Guo
# SPDX-License-Identifier: MIT

config SHIELD_NOIR88_LEFT
    def_bool $(shields_list_contains,Noir88_left)

config SHIELD_NOIR88_RIGHT
    def_bool $(shields_list_contains,Noir88rgb_right)
```
