/*
 * Copyright (c) 2024 Noir Guo
 *
 * SPDX-License-Identifier: MIT
 */

#include "Noir88.dtsi"

&default_transform {
    col-offset = <10>;
};

&kscan0 {
    col-gpios
        = <&gpio1 11 GPIO_ACTIVE_HIGH>
        , <&gpio0 2 GPIO_ACTIVE_HIGH>
        , <&gpio1 15 GPIO_ACTIVE_HIGH>
        , <&gpio1 13 GPIO_ACTIVE_HIGH>
        , <&gpio0 29 GPIO_ACTIVE_HIGH>
        , <&gpio0 31 GPIO_ACTIVE_HIGH>
        , <&gpio1 4 GPIO_ACTIVE_HIGH>
        , <&gpio1 6 GPIO_ACTIVE_HIGH>
        , <&gpio0 11 GPIO_ACTIVE_HIGH>
        , <&gpio1 0 GPIO_ACTIVE_HIGH>
        ;

};

&right_encoder {
    status = "okay";
};
